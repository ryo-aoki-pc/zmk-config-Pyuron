## boards/shields/Pyuron/Kconfig.defconfig
```kconfig
if SHIELD_PYURON_L || SHIELD_PYURON_R
    config ZMK_KEYBOARD_NAME
        default "Pyuron"

    config NFCT_PINS_AS_GPIOS
        default y

    config ZMK_SPLIT
        default y

    config ZMK_POINTING
        default y

    config PAW3222
        default y

    config INPUT
        default y

    config SPI
        default y
endif
```

## config/west.yml
```yaml
manifest:
  remotes:
    - name: zmkfirmware 
      url-base: https://github.com/zmkfirmware
    - name: MeowCatpawkittie
      url-base: https://github.com/MeowCatpawkittie
    - name: caksoylar
      url-base: https://github.com/caksoylar  
    - name: sekigon-gonnoc
      url-base: https://github.com/sekigon-gonnoc
  projects:
    - name: zmk
      remote: zmkfirmware
      revision: 773dec58eaacaef4703b3e4595e50bd71f6cad3d
      import: app/west.yml
    - name: zmk-driver-paw3222
      remote: sekigon-gonnoc
      revision: df652881be2520bde4f64ab6ca35e4c5708f4f9b
    - name: zmk-rgbled-widget
      remote: caksoylar
      revision: 9cef5af88c26e4b86a2a448160055dc740c14d6f
  self:
    path: config
```
